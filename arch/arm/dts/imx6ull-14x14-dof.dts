// SPDX-License-Identifier: (GPL-2.0 OR MIT)
//
// Copyright (C) 2016 Freescale Semiconductor, Inc.

/dts-v1/;

#include "imx6ull.dtsi"
#include "imx6ul-14x14-dof.dtsi"
#include "imx6ul-14x14-dof-u-boot.dtsi"

/ {
	model = "i.MX6 ULL 14x14 DOF Board";
	compatible = "fsl,imx6ull-14x14-dof", "fsl,imx6ull";
};

&clks {
	assigned-clocks = <&clks IMX6UL_CLK_PLL3_PFD2>;
	assigned-clock-rates = <320000000>;
};
