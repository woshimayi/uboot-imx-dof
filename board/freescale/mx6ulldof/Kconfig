## board/freescale/mx6ulldof/Kconfig
```kconfig
if TARGET_MX6ULL_14X14_DOF || TARGET_MX6ULL_9X9_EVK

config SYS_BOARD
	default "mx6ulldof"

config SYS_VENDOR
	default "freescale"

config SYS_CONFIG_NAME
	default "mx6ulldof"

config SYS_TEXT_BASE
	default 0x87800000
endif
```
